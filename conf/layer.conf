## conf/layer.conf
```bitbake
# We have a conf and classes directory, add to BBPATH
BBPATH .= ":${LAYERDIR}"

# We have recipes-* directories, add to BBFILES
BBFILES += "${LAYERDIR}/recipes-*/*/*.bb \
            ${LAYERDIR}/recipes-*/*/*.bbappend"

BBFILE_COLLECTIONS += "meta-aquino"
BBFILE_PATTERN_meta-aquino = "^${LAYERDIR}/"
BBFILE_PRIORITY_meta-aquino = "6"

LAYERDEPENDS_meta-aquino = "core"
LAYERSERIES_COMPAT_meta-aquino = "dunfell"
```
